## boards/iar/custom_aca/Kconfig.custom_aca
```kconfig
# Copyright (c) 2026 IAR Systems AB
# SPDX-License-Identifier: Apache-2.0

config BOARD_CUSTOM_ACA
	select SOC_STM32F429XX
```

## boards/iar/custom_aca/board.yml
```yaml
board:
  name: custom_aca
  full_name: CUSTOM-STM32F429II-ACA
  vendor: iar
  socs:
    - name: stm32f429xx
```

## boards/iar/custom_aca/custom_aca_defconfig
```kconfig
# Copyright (c) 2026 IAR Systems AB
# SPDX-License-Identifier: Apache-2.0

# Enable MPU.
CONFIG_ARM_MPU=y

# Enable HW stack protection.
CONFIG_HW_STACK_PROTECTION=y

# Enable GPIO on all configurations for convenience.
CONFIG_GPIO=y
```

## drivers/button/Kconfig
```kconfig
# Copyright (c) 2026 IAR Systems AB
# SPDX-License-Identifier: Apache-2.0

config BUTTON
  bool "Custom button driver"
  default y
  depends on GPIO
  help
    Enable custom button driver.

config BUTTON_INIT_PRIORITY
  int "Initialization priority"
  default 80
  depends on BUTTON
```

## dts/bindings/button/custom-button.yaml
```yaml
# Copyright (c) 2026 IAR Systems AB
# SPDX-License-Identifier: Apache-2.0

description: |
  Custom button driver

compatible: "custom-button"

include: [ gpio-keys.yaml ]

properties:
  label:
    type: string
    required: false
    description: Human-readable label for the button.
  gpios:
    type: phandle-array
    required: true
    description: GPIO pin for the custom button.
```
